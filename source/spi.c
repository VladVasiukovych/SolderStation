//***************************************************************************
//
//  Author(s)...: Pashgan    http://ChipEnable.Ru
//
//  Target(s)...: Mega
//
//  Compiler....:
//
//  Description.: Драйвер SPI
//
//  Data........: 2.10.12
//
//***************************************************************************
#include "spi.h"


/*инициализация SPI*/
void SPI_Init(void)
{
	/*настройка портов ввода-вывода
	все выводы, кроме MISO выходы*/
	SPI_DDRX = (1<<SPI_MOSI)|(1<<SPI_SCK)|(1<<SPI_SS)|(0<<SPI_MISO);
	SPI_PORTX = (1<<SPI_MOSI)|(1<<SPI_SCK)|(1<<SPI_SS)|(1<<SPI_MISO);
	
	/*разрешение spi,старший бит вперед,мастер, режим 0*/
	SPCR |=
	(0<<SPIE)|				//Разрешение прерываний от SPI
	(1<<SPE)|				//Включение модуля SPI
	(0<<DORD)|				//Порядок передачи данных (1 - младшим битом вперёд, 0 - старшим битом вперёд)
	(1<<MSTR)|				//Режим работы МК (1 - режим master)
	(0<<CPOL)|				//Полярность тактового сигнала (1 - тактовый сигнал начинается с уровня логической единицы, 0 - с уровня логического нуля)
	(0<<CPHA)|				//Фаза тактового сигнала (1 - защелкивание данных выполняется по падающему фронту, 0 - защелкивание данных выполняется по нарастающему фронту)
	(0<<SPR1)|(0<<SPR0);	//Частота тактового сигнала SPI /64
	//-----------------------------------------------------------------------------------------------------------
	SPSR |=			//Статусный регистр
	(0<<SPIF)|		//Флаг прерывания от SPI
	(0<<WCOL)|		//Флаг конфликта записи. Флаг устанавливается в 1, если во время передачи данных выполняется попытка записи в регистр данных SPDR. Флаг сбрасывается аппаратно после чтения регистра SPSR с последующим обращением к регистру данных SPDR.
	(0<<SPI2X);		//Бит удвоения скорости обмена тактового сигнала SPI
}

/*отослать байт данных по SPI*/
void SPI_WriteByte(uint8_t data)
{
	SPI_PORTX &= ~(1<<SPI_SS);
	SPDR = data;
	while(!(SPSR & (1<<SPIF)));
	SPI_PORTX |= (1<<SPI_SS);
}


/*отослать и получить байт данных по SPI*/
uint8_t SPI_ReadByte(uint8_t data)
{
	uint8_t report;
	
	SPI_PORTX &= ~(1<<SPI_SS);
	SPDR = data;
	while(!(SPSR & (1<<SPIF)));
	report = SPDR;
	SPI_PORTX |= (1<<SPI_SS);
	
	return report;
}

/*отправить несколько байт данных по SPI*/
void SPI_WriteArray(uint8_t num, uint8_t *data)
{
	SPI_PORTX &= ~(1<<SPI_SS);
	while(num--){
		SPDR = *data++;
		while(!(SPSR & (1<<SPIF)));
	}
	SPI_PORTX |= (1<<SPI_SS);
}

/*отправить и получить несколько байт данных по SPI*/
void SPI_ReadArray(uint8_t num, uint8_t *data)
{
	SPI_PORTX &= ~(1<<SPI_SS);
	while(num--){
		SPDR = *data;
		while(!(SPSR & (1<<SPIF)));
		*data++ = SPDR;		//адресная арифметика
	}
	SPI_PORTX |= (1<<SPI_SS);
}